## main/Kconfig.projbuild
```kconfig
menu "ResPECT Wifi configuration"

    config RESPECT_WIFI_SSID
        string "WiFi SSID"
        default "myssid"
        help
            SSID (network name) for the example to connect to.

    config RESPECT_WIFI_PASS
        string "WiFi Password"
        default "mypassword"
        help
            WiFi password (WPA or WPA2) for the example to use.

    config RESPECT_MAX_RETRY
        int "Max retry"
        default 5
        help
            Number of retries before aborting connection attempts.


endmenu
```
